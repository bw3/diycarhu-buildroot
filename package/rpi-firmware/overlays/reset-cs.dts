/dts-v1/;
/plugin/;

/ {
 compatible = "brcm,bcm2835";

 fragment@0 {
  target = <&spi0>;
  __overlay__ {
   cs-gpios = <&gpio 8 1>, <&gpio 45 1>;
  };
 };

 fragment@1 {
  target = <&spi0_cs_pins>;
  __overlay__ {
   brcm,pins = <8 45>;
  };
 };

};
